## boards/riscv/blackparrot/Kconfig.blackparrot
```kconfig
# Copyright (c) 2024 University of Washington
# SPDX-License-Identifier: Apache-2.0

config BOARD_RISCV_BLACKPARROT
    select SOC_RISCV_BLACKPARROT
```

## boards/riscv/blackparrot/Kconfig.board
```kconfig
# SPDX-License-Identifier: Apache-2.0

config BOARD_BLACKPARROT
	bool "BlackParrot target"
	depends on SOC_RISCV_BLACKPARROT
```

## boards/riscv/blackparrot/blackparrot_defconfig
```kconfig
# SPDX-License-Identifier: Apache-2.0
CONFIG_SOC_RISCV_BLACKPARROT=y
CONFIG_BOARD_BLACKPARROT=y

CONFIG_CONSOLE=y
CONFIG_SERIAL=y
CONFIG_UART_CONSOLE=y
CONFIG_UART_NS16550=y
CONFIG_UART_INTERRUPT_DRIVEN=n

CONFIG_XIP=n

#CONFIG_SYS_CLOCK_HW_CYCLES_PER_SEC=10000000
#CONFIG_RISCV_GP=y
#CONFIG_NUM_IRQS=64
#CONFIG_PMP_SLOTS=4
#
#CONFIG_64BIT=y
#CONFIG_CPU_HAS_FPU_DOUBLE_PRECISION=y
#CONFIG_ATOMIC_OPERATIONS_BUILTIN=y
#CONFIG_INCLUDE_RESET_VECTOR=y
#CONFIG_RISCV_ISA_RV64I=y
#CONFIG_RISCV_ISA_EXT_M=y
#CONFIG_RISCV_ISA_EXT_A=y
#CONFIG_RISCV_ISA_EXT_F=y
#CONFIG_RISCV_ISA_EXT_D=y
#CONFIG_RISCV_ISA_EXT_C=y
#CONFIG_RISCV_ISA_EXT_ZICSR=y
#CONFIG_RISCV_ISA_EXT_ZIFENCEI=y
```

## custom/boards/riscv/blackparrot/Kconfig.blackparrot
```kconfig
# Copyright (c) 2024 University of Washington
# SPDX-License-Identifier: Apache-2.0

config BOARD_BLACKPARROT
    select SOC_BLACKPARROT
    
```

## custom/boards/riscv/blackparrot/board.yml
```yaml
# Copyright (c) 2024 University of Washington
# SPDX-License-Identifier: Apache-2.0

board:
  name: blackparrot
  vendor: riscv
  socs:
    - name: blackparrot
```

## custom/soc/riscv/blackparrot/Kconfig
```kconfig
# Copyright (c) 2024 University of Washington
# SPDX-License-Identifier: Apache-2.0

config SOC_BLACKPARROT
    bool

    select 64BIT
    select CPU_HAS_FPU_DOUBLE_PRECISION

    # RISC-V options
    select RISCV
    select RISCV_PRIVILEGED

    select ATOMIC_OPERATIONS_BUILTIN
    select RISCV_ISA_RV64I
    select RISCV_ISA_EXT_M
    select RISCV_ISA_EXT_A
    select RISCV_ISA_EXT_F
    select RISCV_ISA_EXT_D
    select RISCV_ISA_EXT_C
    select RISCV_ISA_EXT_ZICSR
    select RISCV_ISA_EXT_ZIFENCEI
    select RISCV_ABI_LP64

    select INCLUDE_RESET_VECTOR
```

## custom/soc/riscv/blackparrot/Kconfig.defconfig
```kconfig
# Copyright (c) 2024 University of Washington
# SPDX-License-Identifier: Apache-2.0

if SOC_BLACKPARROT

config SYS_CLOCK_HW_CYCLES_PER_SEC
    default 10000000

config RISCV_GP
    default y

config NUM_IRQS
    default 64

endif # SOC_BLACKPARROT
```

## custom/soc/riscv/blackparrot/Kconfig.soc
```kconfig
config SOC_BLACKPARROT
    bool

config SOC
    default "blackparrot" if SOC_BLACKPARROT
```

## soc/riscv/blackparrot/Kconfig.defconfig
```kconfig
if SOC_RISCV_BLACKPARROT

config SOC
    default "blackparrot"

config SYS_CLOCK_HW_CYCLES_PER_SEC
    default 10000000

config RISCV_SOC_INTERRUPT_INIT
    default y

config RISCV_HAS_CPU_IDLE
    default n

config RISCV_HAS_PLIC
    default n

config RISCV_GP
    default n

config 2ND_LVL_ISR_TBL_OFFSET
    default 12

config 2ND_LVL_INTR_00_OFFSET
    default 11

config MAX_IRQ_PER_AGGREGATOR
    default 52

config NUM_IRQS
    default 64

config PMP_SLOTS
    default 16

endif # SOC_RISCV_BLACKPARROT
```

## soc/riscv/blackparrot/Kconfig.series
```kconfig
# Copyright (c) 2023 Rivos Inc.
# SPDX-License-Identifier: Apache-2.0

config SOC_SERIES_RISCV_BLACKPARROT
    bool "BlackParrot implementation"
    select RISCV
    help
      Enable support for BlackParrot
```

## soc/riscv/blackparrot/Kconfig.soc
```kconfig
config SOC_RISCV_BLACKPARROT
    bool "BlackParrot SoC"
    select ARCH_RISCV

config SOC
    default "riscv_blackparrot" if SOC_RISCV_BLACKPARROT
```

## west.yml
```yaml
manifest:
  defaults:
    revision: main

  remotes:
    - name: zephyrproject-rtos
      url-base: https://github.com/zephyrproject-rtos

  defaults:
    remote: zephyrproject-rtos

  projects:
    - name: zephyr
      remote: zephyrproject-rtos
      repo-path: zephyr
      revision: zephyr-v3.4.0
      import: true
   
  self:
    path: bp_board
```
